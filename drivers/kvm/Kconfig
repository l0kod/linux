## drivers/kvm/Kconfig
```kconfig
menu "KVM driver support"
	depends on KVM_GUEST

config KVM_SYS_HYPERVISOR
	bool "Create KVM entries under /sys/hypervisor"
	depends on SYSFS && PARAVIRT_CR_PINNING
	select SYS_HYPERVISOR
	default y
	help
	  sysfs entries for Linux guests running under KVM. Expose status of KVM
	  features, whether they are in use or not.

	  Currently exposes a pv_cr_pinning entry under /sys/hypervisor if
	  paravirtualized control register pinning is configured. The contents
	  of the file are 0 for disabled or 1 for enabled.

endmenu
```

## security/yama/Kconfig
```kconfig
config SECURITY_YAMA
	bool "Yama support"
	depends on SECURITY
	default n
	help
	  This selects Yama, which extends DAC support with additional
	  system-wide security settings beyond regular Linux discretionary
	  access controls. Currently available are ptrace scope restriction and
	  enforcement of the O_MAYEXEC open flag.
	  Like capabilities, this security module stacks with other LSMs.
	  Further information can be found in
	  Documentation/admin-guide/LSM/Yama.rst.

	  If you are unsure how to answer this question, answer N.
```
